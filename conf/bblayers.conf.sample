## conf/bblayers.conf.sample
```bitbake
# POKY_BBLAYERS_CONF_VERSION is increased each time build/conf/bblayers.conf
# changes incompatibly
POKY_BBLAYERS_CONF_VERSION = "2"

BBPATH = "${TOPDIR}"
BBFILES ?= ""

BBLAYERS ?= " \
    /home/localadmin/repos/rpi/rpi_yocto/sources/poky/meta \
    /home/localadmin/repos/rpi/rpi_yocto/sources/poky/meta-poky \
    /home/localadmin/repos/rpi/rpi_yocto/sources/meta-openembedded/meta-oe \
    /home/localadmin/repos/rpi/rpi_yocto/sources/meta-openembedded/meta-multimedia \
    /home/localadmin/repos/rpi/rpi_yocto/sources/meta-openembedded/meta-networking \
    /home/localadmin/repos/rpi/rpi_yocto/sources/meta-openembedded/meta-python \
    /home/localadmin/repos/rpi/rpi_yocto/sources/meta-qt5 \
    /home/localadmin/repos/rpi/rpi_yocto/sources/meta-raspberrypi \
    /home/localadmin/repos/rpi/rpi_yocto/sources/meta-rpi \
  "
```
